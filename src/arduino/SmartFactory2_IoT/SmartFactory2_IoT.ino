/******************************************************************************************
 * FileName     : SmartFactory2_IoT.ino
 * Description  : 이티보드 스마트 팩토리2 코딩 키트(IoT)
 * Author       : SCS
 * Created Date : 2023.11.09
 * Reference    : 
 * Modified     : 
 * Modified     : 
 * Modified     : 
******************************************************************************************/
const char* board_hardware_verion = "ETBoard_V1.1";
const char* board_firmware_verion = "smartFty_0.92";

#include <Servo.h>

Servo servo;                                           // 서보모터 선언

//==========================================================================================
// 응용 프로그램 구성 사용하기                       
//==========================================================================================
#include "app_config.h"
APP_CONFIG app;


//==========================================================================================
// 상수 정의                                       
//==========================================================================================
// 메시지 송신 주기 : 주의!!!! 너무 빨리 또는 많이 보내면 서버에서 거부할 수 있음(Banned)
//------------------------------------------------------------------------------------------
#define NORMAL_SEND_INTERVAL  (1000 * 5)          // 권장 5초 (단위: 초/1000)
#define PUSH_LENGTH 44


//==========================================================================================
// ETBoard 핀번호 설정                                   
//==========================================================================================
const int button_push = D7;                       // 밀기 버튼 (D7 = 파랑 버튼)

const int echo_pin = D8;                          // 초음파 센서 수신부
const int trig_pin = D9;                          // 초음파 센서 송신부

static const int servoPin = D6;                   // 서보모터

const int operation_mode_led = D4;                // 작동 모드 LED

int count = 0;                                    // 카운터용 변수
int pre_time = 0;                                 // 이전에 물건이 지나간 시간

float distance;                                   // 초음파 센서 값(거리)
char text1[255] = {0, };                          // 포멧팅용 임시 버퍼
char text2[255] = {0, };                          // 포멧팅용 임시 버퍼
int conveyor_status = 0;                          // 컨베이어 위치 상태 
                                                  // 0(초기 위치), 1(1개 공급), 2, 3

//==========================================================================================
void setup()                                      // 설정 함수 
//==========================================================================================
// (권장 사항) 이 함수에서는 코딩하지 마십시오. custom_setup()에 코딩하십시오.
//------------------------------------------------------------------------------------------
{
    app.setup();                                  // 응용 프로그램 기본 설정
    custom_setup();                               // 사용자 맞춤형 설정
  
    oled_show(count);                             // OLED 기본 설정
}


//==========================================================================================
void custom_setup()                               // 사용자 맞춤형 설정 함수
//==========================================================================================
{
    //--------------------------------------------------------------------------------------
    // 여기에 사용자 맞춤형 설정을 코딩하세요.
    //--------------------------------------------------------------------------------------
    // 초음파 센서 핀 설정                            
    //--------------------------------------------------------------------------------------
    pinMode(trig_pin, OUTPUT);                    // 초음파 송신 핀을 출력 모드 설정
    pinMode(echo_pin, INPUT);                     // 초음파 수신 핀을 입력 모드 설정    
    pinMode(button_push, INPUT);                  // 핀 모드 설정
    
    servo.attach(servoPin);                       // 서보모터 핀 설정
    servo.write(170);                             // 초기화1
    delay(100);
    servo.write(180);                             // 초기화2
}


//==========================================================================================
void loop()                                       // 반복 루틴
//==========================================================================================
//  (권장 사항) 이 함수를 가능하면 수정하지 마십시오 !!! 
//  do_sensing_process(), do_automatic_process(), send_sensor_value(), 
//------------------------------------------------------------------------------------------
{
    //--------------------------------------------------------------------------------------
    // MQTT 백그라운드 동작 
    //--------------------------------------------------------------------------------------
    app.mqtt.loop();

    //--------------------------------------------------------------------------------------
    // 센싱 처리
    //--------------------------------------------------------------------------------------       
    do_sensing_process();                             

    //--------------------------------------------------------------------------------------
    // 동작 모드가 automatic 일 경우 자동화 처리
    //--------------------------------------------------------------------------------------      
    if(app.operation_mode == "automatic") {       // 수정 금지
        do_automatic_process();                   // 자동화 처리    
    }
    
    //--------------------------------------------------------------------------------------
    // 주기적으로 메시지 전송 처리
    //--------------------------------------------------------------------------------------
    if (millis() - app.lastMillis > NORMAL_SEND_INTERVAL) {  
        send_sensor_value();                      // 센서 값 송신
        app.lastMillis = millis();                // 현재 시각 업데이트
    }  

    //--------------------------------------------------------------------------------------
    // 동작 상태 LED 깜밖이기
    //--------------------------------------------------------------------------------------  
    app.etboard.normal_blink_led();               
}

//==========================================================================================
void do_servo_process() 
//==========================================================================================
{
        if (conveyor_status > 3) {
            conveyor_status = 0;
        }
        servo.write(180-(PUSH_LENGTH*conveyor_status-12));
        delay(20);
        servo.write(180-(PUSH_LENGTH*conveyor_status-24));
        delay(20);
        servo.write(180-(PUSH_LENGTH*conveyor_status));
        send_conveyor_status();
        delay(100);  
}

//==========================================================================================
void do_sensing_process()                         // 센싱 처리 함수
//==========================================================================================
{ 
    int button_push_status = digitalRead(button_push); // 빨강 버튼의 값을 저장
    if (button_push_status == LOW) {        
        conveyor_status++;
        /*
        if (conveyor_status > 3) {
            conveyor_status = 0;
        }*/
        do_servo_process();
        /*
        servo.write(180-(PUSH_LENGTH*conveyor_status-12));
        delay(20);
        servo.write(180-(PUSH_LENGTH*conveyor_status-24));
        delay(20);
        servo.write(180-(PUSH_LENGTH*conveyor_status));
        */
        oled_show(count);
        send_conveyor_status();
    }
    
    //--------------------------------------------------------------------------------------
    // 거리 값 센싱하기; 초음파 센서
    //--------------------------------------------------------------------------------------  
    delay(60);                                    // 10/1000초 만큼 대기
  
    //--------------------------------------------------------------------------------------
    // 초음파 측정
    //--------------------------------------------------------------------------------------  
    digitalWrite(trig_pin, LOW);                  // 초음파 센서 거리 센싱 시작
    delayMicroseconds(2);
    digitalWrite(trig_pin, HIGH);
    delayMicroseconds(10);
    digitalWrite(trig_pin, LOW);                  // 초음파 센서 거리 센싱 종료

  
    //--------------------------------------------------------------------------------------
    // 초음파 수신 값으로 거리 계산
    //--------------------------------------------------------------------------------------  
    float duration = pulseIn (echo_pin, HIGH);    // 물체에 반사되어 돌아온 초음파의 시간을 저장
    distance = ((34 * duration) / 1000) / 2;      // 측정된 값을 cm로 변환하는 공식
    //Serial.println(distance);
}


//==========================================================================================
void oled_show(int count)
//==========================================================================================
{
    delay(10);
    sprintf(text1, "count : %d", count);
    sprintf(text2, "pos   : %d", conveyor_status);
    app.oled.setLine(1, "*Smart Factory");        // OLED 첫 번째 줄 : 시스템 이름
    app.oled.setLine(2, text1);                   // OLED 두 번째 줄 : 지나간 물체 갯수
    app.oled.setLine(3, text2);                   // OLED 두 번째 줄 : 지나간 물체 갯수    
    app.oled.display();
}

//==========================================================================================
void do_automatic_process()                       // 자동화 처리 함수
//==========================================================================================
// 여기에 자동화 처리를 코딩하세요.
//------------------------------------------------------------------------------------------
{  
    //--------------------------------------------------------------------------------------  
    // 스마트 펙토리 시스템
    //--------------------------------------------------------------------------------------  
    Serial.print("distance=");
    Serial.println(distance);
    if(distance > 2 && distance < 8)              // 물체와의 거리가 2cm 초과 10cm 미만이면 
    {
        int now_time = millis();
        if(now_time - pre_time > 500)
        {
            count += 1;                           // 물체가 지나가면  count 1증가
            send_sensor_value();                  // 2023.11.09 : SCS
            
            oled_show(count);                     // OLED 에 count 변수 값 표시
            delay(1000);

            pre_time = now_time;
        }
    }
}


//==========================================================================================
void send_sensor_value()                          // 센서 값 송신 함수
//==========================================================================================
{ 
    // 예시 {"count":18}
    DynamicJsonDocument doc(256);                 // json 
    doc["count"] = count;                         // 지나간 물체 갯수

    String output;                                // 문자열 변수
    serializeJson(doc, output);                   // json을 문자열로 변환
    app.mqtt.publish_tele("/sensor", output);     // 송신
}

//==========================================================================================
void send_conveyor_status()                       // 컨베이어 위치 상태 송신 함수
//==========================================================================================
{ 
    // 예시 {"state":0}    
    DynamicJsonDocument doc(256);                 // json 
    doc["state"] = conveyor_status;               // conveyor 위치 상태

    String output;                                // 문자열 변수
    serializeJson(doc, output);                   // json을 문자열로 변환
    app.mqtt.publish_tele("/conveyor", output);   // 송신
}

//==========================================================================================
void onConnectionEstablished()                    // MQTT 연결되었을 때 동작하는 함수
//==========================================================================================
{
    app.mqtt.onConnectionEstablished();           // MQTT 연결되었을 때 동작
    recv_automatic_mode();                        // 동작 모스 수신 설정
}


//==========================================================================================
void recv_automatic_mode(void)                    // 동작 모드 수신 함수
//==========================================================================================
{
    app.mqtt.client.subscribe(
        app.mqtt.get_cmnd_prefix() + "/operation_mode",        // 작동 모드 명령을 수신
        [&](const String & payload) {                          // 명령 내용을 payload에 저장       
            pinMode(operation_mode_led, OUTPUT);               // operation_mode_led 핀을 출력 모드로 설정
            if (payload == "automatic"){                       // 명령이 자동이면
                app.operation_mode = "automatic";              // 작동 모드를 자동으로 설정
                digitalWrite(operation_mode_led, HIGH);        // 작동 모드 LED 켜기
            }
            else{
                app.operation_mode = "manual";                 // 작동 모드를 수동으로 설정
                digitalWrite(operation_mode_led, LOW);         // 작동 모드 LED 끄기
            }
        });

    app.mqtt.client.subscribe(
        app.mqtt.get_cmnd_prefix() + "/count",                 // count 명령을 수신
        [&](const String & payload) {                          // 명령 내용을 payload에 저장       
            int tmp_count;
            tmp_count = payload.toInt();           
            if (tmp_count > -1) count = tmp_count;             // 카운트 변경
            oled_show(count);                                  // OLED 기본 설정
        });          

    app.mqtt.client.subscribe(
        app.mqtt.get_cmnd_prefix() + "/conveyor",              // conveyor 명령을 수신
        [&](const String & payload) {                          // 명령 내용을 payload에 저장       
            int tmp_status;
            tmp_status = payload.toInt();           
            if (tmp_status <= -1 && tmp_status >= 3)     
            {
                return;
            }
            conveyor_status = tmp_status;                      // conveyor status(위치)
            do_servo_process();        
            oled_show(count);
            send_conveyor_status();
        }); 
}

//==========================================================================================
//                                                    
// (주)한국공학기술연구원 http://et.ketri.re.kr       
//                                                    
//==========================================================================================
